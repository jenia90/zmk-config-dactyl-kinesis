## config/boards/shields/dactyl_kinesis/Kconfig.defconfig
```kconfig
if SHIELD_DACTYL_KINESIS_LEFT

    config ZMK_KEYBOARD_NAME
        default "dactyl_kinesis"

    config ZMK_SPLIT_ROLE_CENTRAL
        default y

endif

if SHIELD_DACTYL_KINESIS_LEFT || SHIELD_DACTYL_KINESIS_RIGHT

    config ZMK_SPLIT
        default y

    if ZMK_RGB_UNDERGLOW

    config WS2812_STRIP
        default y
    endif

endif
```

## config/boards/shields/dactyl_kinesis/Kconfig.shield
```kconfig
config SHIELD_DACTYL_KINESIS_LEFT
    def_bool $(shields_list_contains,dactyl_kinesis_left)

config SHIELD_DACTYL_KINESIS_RIGHT
    def_bool $(shields_list_contains,dactyl_kinesis_right)
```

## config/boards/shields/switch_tester/Kconfig.defconfig
```kconfig
if SHIELD_SWITCH_TESTER

    config ZMK_KEYBOARD_NAME
        default "switch_tester"
    
endif
```
